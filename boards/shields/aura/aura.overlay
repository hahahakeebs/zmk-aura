#include "heatwave.dtsi"

kscan0: kscan_0 {
    compatible = "zmk,kscan-gpio-matrix";
    label = "KSCAN";
    diode-direction = "col2row";

    col-gpios
    = <&gpio0 2 (GPIO_ACTIVE_HIGH)> // col 1
    , <&gpio0 3 (GPIO_ACTIVE_HIGH)> // col 2
    , <&gpio0 28 (GPIO_ACTIVE_HIGH)> // col 3
    , <&gpio0 29 (GPIO_ACTIVE_HIGH)> // col 4
    , <&gpio0 4 (GPIO_ACTIVE_HIGH)> // col 5
    , <&gpio1 12 (GPIO_ACTIVE_HIGH)> // col 6
    , <&gpio1 3 (GPIO_ACTIVE_HIGH)> // col 7
    , <&gpio1 5 (GPIO_ACTIVE_HIGH)> // col 8
    , <&gpio1 14 (GPIO_ACTIVE_HIGH)> // col 9
    , <&gpio1 7 (GPIO_ACTIVE_HIGH)> // col 10
    ;
    row-gpios
    = <&gpio0 15 (GPIO_ACTIVE_HIGH | GPIO_PULL_DOWN)> // row 1
    , <&gpio0 19 (GPIO_ACTIVE_HIGH | GPIO_PULL_DOWN)> // row 2
    , <&gpio1 1 (GPIO_ACTIVE_HIGH | GPIO_PULL_DOWN)> // row 3
    , <&gpio0 9 (GPIO_ACTIVE_HIGH | GPIO_PULL_DOWN)> // row 4
    ;
};
